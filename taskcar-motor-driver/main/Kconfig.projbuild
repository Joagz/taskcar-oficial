## taskcar-motor-driver/main/Kconfig.projbuild
```kconfig
menu "CONFIGURACIÓN DEL DRIVER (MOTOR)"
    config MOTOR_LEFT_GPIO
        int "PIN ENABLE MOTOR IZQUIERO"
        default 5
        help
            Número de PIN para el puerto ENABLE del motor izquierdo

    config MOTOR_RIGHT_GPIO
        int "PIN ENABLE MOTOR DERECHO"
        default 27
        help
            Número de PIN para el puerto ENABLE del motor derecho

    config MOTOR_LEFT_IN1
        int "IN1 MOTOR IZQUIERDO"
        default 16
        help
            PIN IN1 del motor izquierdo
        
    config MOTOR_LEFT_IN2
        int "IN2 MOTOR IZQUIERDO"
        default 17
        help
            PIN IN2 del motor izquierdo

    config MOTOR_RIGHT_IN1
        int "IN1 MOTOR DERECHO"
        default 25
        help
            PIN IN1 del motor derecho
        
    config MOTOR_RIGHT_IN2
        int "IN2 MOTOR DERECHO"
        default 26
        help
            PIN IN2 del motor derecho

    config MOTOR_DRIVER_DUTY_RES
        int "DUTY RESOLUTION (BITS)"
        default 13
        help
            Número de ciclos de trabajo disponibles en un periodo de PWM

    config MOTOR_DRIVER_PWM_FREQ
        int "PWM FREQUENCY (Hz)"
        default 5000 
        help
            Número de períodos de PWM por segundo (Hz)
endmenu

menu "WIFI CONFIGURATION"

    config ESP_WIFI_SSID
        string "WiFi SSID"
        default "myssid"
        help
            SSID (network name) for the example to connect to.

    config ESP_WIFI_PASSWORD
        string "WiFi Password"
        default "mypassword"
        help
            WiFi password (WPA or WPA2) for the example to use.

    choice ESP_WIFI_SAE_MODE
        prompt "WPA3 SAE mode selection"
        default ESP_WPA3_SAE_PWE_BOTH
        help
            Select mode for SAE as Hunt and Peck, H2E or both.
        config ESP_WPA3_SAE_PWE_HUNT_AND_PECK
            bool "HUNT AND PECK"
        config ESP_WPA3_SAE_PWE_HASH_TO_ELEMENT
            bool "H2E"
        config ESP_WPA3_SAE_PWE_BOTH
            bool "BOTH"
    endchoice

    config ESP_WIFI_PW_ID
        string "PASSWORD IDENTIFIER"
        depends on  ESP_WPA3_SAE_PWE_HASH_TO_ELEMENT|| ESP_WPA3_SAE_PWE_BOTH
        default ""
        help
            password identifier for SAE H2E

    config ESP_MAXIMUM_RETRY
        int "Maximum retry"
        default 5
        help
            Set the Maximum retry to avoid station reconnecting to the AP unlimited when the AP is really inexistent.

    choice ESP_WIFI_SCAN_AUTH_MODE_THRESHOLD
        prompt "WiFi Scan auth mode threshold"
        default ESP_WIFI_AUTH_WPA2_PSK
        help
            The weakest authmode to accept in the scan mode.
            This value defaults to ESP_WIFI_AUTH_WPA2_PSK incase password is present and ESP_WIFI_AUTH_OPEN is used.
            Please select ESP_WIFI_AUTH_WEP/ESP_WIFI_AUTH_WPA_PSK incase AP is operating in WEP/WPA mode.

        config ESP_WIFI_AUTH_OPEN
            bool "OPEN"
        config ESP_WIFI_AUTH_WEP
            bool "WEP"
        config ESP_WIFI_AUTH_WPA_PSK
            bool "WPA PSK"
        config ESP_WIFI_AUTH_WPA2_PSK
            bool "WPA2 PSK"
        config ESP_WIFI_AUTH_WPA_WPA2_PSK
            bool "WPA/WPA2 PSK"
        config ESP_WIFI_AUTH_WPA3_PSK
            bool "WPA3 PSK"
        config ESP_WIFI_AUTH_WPA2_WPA3_PSK
            bool "WPA2/WPA3 PSK"
        config ESP_WIFI_AUTH_WAPI_PSK
            bool "WAPI PSK"
    endchoice

endmenu
```
